## components/qq_mqtt_client/Kconfig.projbuild
```kconfig
menu "QQ MQTT Config"

    config QQ_CLIENT_ID
        string "QQ Client ID"
        default "qq0"
        help
            The unique ID for this QQ client

endmenu
```
